## ports/ninjapilot-litewing/esp-idf/main/Kconfig.projbuild
```kconfig
menu "LiteWing diagnostic build"
config LRRK_BENCH_OUTPUT_LIMIT
    bool "Bench-only output ceiling and one-shot deadline (NOT FOR FLIGHT)"
    default n
    help
        Clamp each motor to 200/1000 duty. After the first eligible nonzero
        frame, latch outputs off at the configured deadline, checked by
        output updates and the 20 ms watchdog. Actual scheduling latency
        must be measured on hardware; this is not a hardware cutoff.
        Reset is required for another interval. Normal arming, IMU health
        and failsafe requirements remain. Never use this build for flight.
config LRRK_BENCH_OUTPUT_DURATION_MS
    int "One-shot bench output duration (milliseconds)"
    depends on LRRK_BENCH_OUTPUT_LIMIT
    range 1000 10000
    default 1000
    help
        Elapsed interval from the first eligible nonzero frame, not accumulated
        motor-on time. Fresh commands and rearming cannot extend this deadline.
        A longer interval does not override host aborts or any firmware fault.
config LRRK_BENCH_SINGLE_MOTOR
    bool "Props-off diagnostic: fixed channel 1 duty (NOT FOR FLIGHT)"
    depends on LRRK_BENCH_OUTPUT_LIMIT
    default n
    help
        When sanitized controller demand is nonzero, apply fixed 200/1000
        duty to channel 1 only. All other channels stay zero. Zero demand,
        disarm, IMU faults, failsafe and the one-shot deadline still stop
        output. Sensor readings and controller settings are not changed.
        This isolates applied motor output from mixer variation for a
        props-off bench observation. Never use this profile for flight.
config LRRK_ATTITUDE_TRACE
    bool "Capture one bounded attitude/PWM trace in RAM"
    depends on LRRK_BENCH_OUTPUT_LIMIT
    default n
    help
        Bench-only 512-record capture with 64 pretrigger updates. Trigger on
        first observed nonzero unsuppressed PWM; download after freeze.
        Does not alter controller inputs, arming or output bounds.
endmenu
```
